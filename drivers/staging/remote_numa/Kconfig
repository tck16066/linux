## drivers/staging/remote_numa/ping_tests/Kconfig
```kconfig
config REMOTE_NUMA
    tristate "My Test Modules for remote numa"
    default m
    help
        Experimental remote NUMA memory/test modules.
```
